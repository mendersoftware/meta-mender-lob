## conf/layer.conf
```bitbake
# We have a conf and classes directory, add to BBPATH
BBPATH .= ":${LAYERDIR}"

# We have recipes-* directories, add to BBFILES
BBFILES += "${LAYERDIR}/recipes-*/*/*.bb \
            ${LAYERDIR}/recipes-*/*/*.bbappend"

BBFILE_COLLECTIONS += "meta-mender-lob"
BBFILE_PATTERN_meta-mender-lob = "^${LAYERDIR}/"
BBFILE_PRIORITY_meta-mender-lob = "6"

IMAGE_INSTALL_append = " sd-mux tplink-smarthome-api sd-smart-flasher"

LAYERSERIES_COMPAT_meta-mender-lob = "sumo"
```
